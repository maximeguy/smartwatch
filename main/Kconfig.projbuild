## main/Kconfig.projbuild
```kconfig
menu "Example Configuration"
    config WIFI_SSID
        string "WiFi SSID"
        default "MG_Pxl"
        help
            WiFi network identifier.
            
    config WIFI_PASSWORD
        string "WiFi Password"
        default "87654321"
        help
            WiFi network password.
            
    config BLINK_GPIO
        int "Blink GPIO number"
        range 0 34
        default 2
        help
            GPIO number (IOxx) to blink on and off.

            Some GPIOs are used for other purposes (flash connections, etc.) and cannot be used to blink.

            GPIOs 35-39 are input-only so cannot be used as outputs.

endmenu
```
